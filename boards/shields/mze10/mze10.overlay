/*
 * Copyright (c) 2022 PleaseWaitt
 *
 * SPDX-License-Identifier: MIT
 */

#include "mze10.dtsi"

/ {
	chosen {
		zmk,kscan = &kscan0;
	};

	kscan0: kscan {
		compatible = "zmk,kscan-gpio-direct";
		input-gpios
			= 	<&xiao_d  1 (GPIO_ACTIVE_LOW | GPIO_PULL_UP)>,
				<&xiao_d  3 (GPIO_ACTIVE_LOW | GPIO_PULL_UP)>,
				<&xiao_d  5 (GPIO_ACTIVE_LOW | GPIO_PULL_UP)>,
				<&xiao_d  8 (GPIO_ACTIVE_LOW | GPIO_PULL_UP)>,
				<&xiao_d  10 (GPIO_ACTIVE_LOW | GPIO_PULL_UP)>

			;

	};

};
